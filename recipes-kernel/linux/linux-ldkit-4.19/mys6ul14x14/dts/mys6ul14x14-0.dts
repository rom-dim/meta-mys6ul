/*
 * Copyright (C) 2017 MYiR Tech.
 *
 * This program is free software; you can redistribute it and/or modify
 * it under the terms of the GNU General Public License version 2 as
 * published by the Free Software Foundation.
 */

#include "mys-imx6ul-14x14-evk-gpmi-weim-lcd070.dts"
