## conf/machine/mys6ul14x14.conf
```bitbake
#@TYPE: Machine
#@NAME: Udoo Neo Board
#@SOC: i.MX6SX
#@DESCRIPTION: This is a small board from company udoo wich we use(d) as development board
#@MAINTAINER: Dmitrij Belousov dmitirj.belousov@rohde-schwarz.com


include conf/machine/include/imx-base.inc
include conf/machine/include/tune-cortexa7.inc

MACHINEOVERRIDES =. "mx6:mx6ul:"

KERNEL_DEVICETREE ?= " \
	mys-imx6ul-14x14-evk-gpmi-weim-lcd070.dtb \
	mys-imx6ul-14x14-evk-gpmi-weim-myb6ulx-lcd070.dtb \
	mys-imx6ul-14x14-evk-gpmi-weim-myb6ulx.dtb \
	mys-imx6ul-14x14-evk-gpmi-weim.dtb \
	mys-imx6ul-14x14-evk.dtb \
	mys6ul14x14-0.dtb \
	mys6ul14x14-1.dtb \
"
# Define wich Device Tree file should be used as default/fallback for u-boot. 
# KERNEL_DEFAULT_DEVICETREE will be copied to deploy folder as zImage-${MACHINE}.dtb
# KERNEL_DEFAULT_DEVICETREE should be contained in KERNEL_DEVICETREE
KERNEL_DEFAULT_DEVICETREE = "mys6ul14x14-1.dtb"

KERNEL_IMAGETYPE = "zImage"

PREFERRED_VERSION_linux-ldkit ?= "4.1%"
PREFERRED_RPROVIDER_virtual/kernel ?="linux-ldkit"

UBOOT_CONFIG ??= "sd nand emmc"
UBOOT_CONFIG[sd] = "mys_imx6ul_14x14_sd_defconfig,sdcard"
UBOOT_CONFIG[emmc] = "mys_imx6ul_14x14_emmc_defconfig,emmc"
UBOOT_CONFIG[nand] = "mys_imx6ul_14x14_nand_defconfig,nand"

PREFERRED_PROVIDER_u-boot ?= "u-boot-ldkit"
PREFERRED_PROVIDER_virtual/bootloader ?= "u-boot-lpkit"


SERIAL_CONSOLES = "115200;ttymxc0"
```

## recipes-bsp/u-boot/u-boot-lpkit/mys6ul14x14/Kconfig.patch
```kconfig
diff --git a/arch/arm/cpu/armv7/mx6/Kconfig b/arch/arm/cpu/armv7/mx6/Kconfig
index 44a3860..f8385d8 100644
--- a/arch/arm/cpu/armv7/mx6/Kconfig
+++ b/arch/arm/cpu/armv7/mx6/Kconfig
@@ -210,6 +210,13 @@ config TARGET_WANDBOARD
 
 config TARGET_WARP
 	bool "WaRP"
+	
+config TARGET_MYS_IMX6UL_14X14
+	bool "Support MYiR mys-imx6ul_14x14"
+	select MX6UL
+	select SUPPORT_SPL
+	select DM
+	select DM_THERMAL

 endchoice
 
@@ -247,5 +254,6 @@ source "board/tqc/tqma6/Kconfig"
 source "board/udoo/Kconfig"
 source "board/wandboard/Kconfig"
 source "board/warp/Kconfig"
+source "board/myir/mys_imx6ul_14x14/Kconfig"
 
 endif
```
